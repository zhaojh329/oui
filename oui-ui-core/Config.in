## oui-ui-core/Config.in
```kconfig
menu "Configuration"
	depends on PACKAGE_oui-ui-core

	config OUI_BUILD_DEV
	bool "Build for development"
	default n
	depends on PACKAGE_oui-ui-core
	help
	  This turn on development mode. During development, Vue provides
	  a lot of warnings to help you with common errors and pitfalls.

	choice
		prompt "Node compiler config"
		default OUI_USE_OUI_NODE

		config OUI_USE_HOST_NODE
			bool "Host Node"
			help
			   This option select host installled node compile vuejs 

		config OUI_USE_OW_NODE
			bool "OpenWRT node (version must more than 8.11.x)"
			help
			  This enabled the build dependency on the node package from
			  the OpenWrt packages feed.
		
		config OUI_USE_OUI_NODE
			bool "OUI node"
			help
			  Select this option will be use oUI node version for compile VUE code

	endchoice
	
endmenu
```
